// These arguments were used when this file was generated. They will be automatically applied on subsequent loads 
// via the GUI or CLI invocations. Run CLI with '--help' for additional information on how to override these arguments.
// @cliArgs --board "/ti/boards/CC3220SF_LAUNCHXL" --product "SimpleLinkSDK@3.20.00.06"
// @versions {"data":"2019051709","timestamp":"2019051709","tool":"1.1.792","templates":"2019051709"}

var RTOS = scripting.addModule("/ti/drivers/RTOS");
var GPIO = scripting.addModule("/ti/drivers/GPIO");
var GPIO1 = GPIO.addInstance();
var UART = scripting.addModule("/ti/drivers/UART");
var UART1 = UART.addInstance();
var I2C = scripting.addModule("/ti/drivers/I2C");
var I2C1 = I2C.addInstance();
var Timer = scripting.addModule("/ti/drivers/Timer");
var Timer1 = Timer.addInstance();
var GPIO2 = GPIO.addInstance();
var UART2 = UART.addInstance();
var GPIO3 = GPIO.addInstance();
var GPIO4 = GPIO.addInstance();
var Power = scripting.addModule("/ti/drivers/Power");
// Name
Power.parkPins.$name = "ti_drivers_power_PowerCC32XXPins0";
var Board = scripting.addModule("/ti/drivers/Board");
// Name - The C/C++ identifier used in applications as the index parameter passed to GPIO runtime APIs
GPIO1.$name = "COLOR_LED";
// Use Hardware - Select the hardware to use, or 'none' to use available header pins
GPIO1.$hardware = system.deviceData.board.components.LED_RED;
// Name - The C/C++ identifier used in applications as the index parameter passed to UART runtime APIs
UART1.$name = "Board_UART0";
// Name
UART1.uart.$name = "MyUART1";
// Name - The C/C++ identifier used in applications as the index parameter passed to I2C runtime APIs
I2C1.$name = "COLOR_SENSOR_I2C0";
// Name
I2C1.i2c.$name = "MyI2C1";
// Assign pin
I2C1.i2c.sdaPin.$assign = "boosterpack.14"; // P06
// Assign pin
I2C1.i2c.sclPin.$assign = "boosterpack.4"; // P03
// Name - The C/C++ identifier used in applications as the index parameter passed to Timer runtime APIs
Timer1.$name = "COLOR_SENSOR_TIMER";
// Name
Timer1.timer.$name = "MyTimer1";
// Use Hardware - Select the hardware to use, or 'none' to use available header pins
GPIO2.$hardware = system.deviceData.board.components.LED_GREEN;
// Name - The C/C++ identifier used in applications as the index parameter passed to GPIO runtime APIs
GPIO2.$name = "ERROR_LED";
// Name - The C/C++ identifier used in applications as the index parameter passed to UART runtime APIs
UART2.$name = "COLOR_SENSOR_UART";
// Use Hardware - Select the hardware to use, or 'none' to use available header pins
UART2.$hardware = system.deviceData.board.components.xds110Uart;
// Name
UART2.uart.$name = "MyUART1";
// Name - The C/C++ identifier used in applications as the index parameter passed to GPIO runtime APIs
GPIO3.$name = "COLOR_TASK_LED";
// Use Hardware - Select the hardware to use, or 'none' to use available header pins
GPIO3.$hardware = system.deviceData.board.components.LED_YELLOW;
// Name - The C/C++ identifier used in applications as the index parameter passed to GPIO runtime APIs
GPIO4.$name = "SENSOR_LED0";
// Assign pin
GPIO4.gpioPin.$assign = "boosterpack.18"; // P08
// Suggest solution
GPIO1.gpioPin.$suggestSolution = "64";
// Suggest solution
UART1.uart.$suggestSolution = "UART1";
// Suggest solution
UART1.uart.txPin.$suggestSolution = "58";
// Suggest solution
UART1.uart.rxPin.$suggestSolution = "59";
// Suggest solution
I2C1.i2c.$suggestSolution = "I2C0";
// Suggest solution
Timer1.timer.$suggestSolution = "Timer0";
// Suggest solution
GPIO2.gpioPin.$suggestSolution = "2";
// Suggest solution
UART2.uart.$suggestSolution = "UART0";
// Suggest solution
UART2.uart.txPin.$suggestSolution = "55";
// Suggest solution
UART2.uart.rxPin.$suggestSolution = "57";
// Suggest solution
GPIO3.gpioPin.$suggestSolution = "1";
